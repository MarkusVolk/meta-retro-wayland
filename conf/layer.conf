## conf/layer.conf
```bitbake
# We have a conf and classes directory, add to BBPATH
BBPATH .= ":${LAYERDIR}"

# We have recipes-* directories, add to BBFILES
BBFILES += "${LAYERDIR}/recipes-*/*/*.bb ${LAYERDIR}/recipes-*/*/*.bbappend"

BBFILE_COLLECTIONS += "retro-wayland"
BBFILE_PATTERN_retro-wayland = "^${LAYERDIR}/"
BBFILE_PRIORITY_retro-wayland = "7"

# This should only be incremented on significant changes that will
# cause compatibility issues with other layers
LAYERVERSION_retro-wayland = "1"
LAYERSERIES_COMPAT_retro-wayland = "honister"
LAYERDEPENDS_retro-wayland = "core"
```
